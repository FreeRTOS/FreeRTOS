//*****************************************************************************
//
// standalone.xcl - Linker script for EW-ARM.
//
// Copyright (c) 2006 Luminary Micro, Inc.  All rights reserved.
//
//*****************************************************************************

//
// Set the CPU type to ARM.
//
-carm

//
// Define the size of flash and SRAM.
//
-DROMSTART=00000000
-DROMEND=0000FFFF
-DRAMSTART=20000000
-DRAMEND=20001FFF

//
// Define the sections to place into flash, and the order to place them.
//
-Z(CODE)INTVEC=ROMSTART-ROMEND
-Z(CODE)ICODE,DIFUNCT=ROMSTART-ROMEND
-Z(CODE)CODE=ROMSTART-ROMEND
-Z(CONST)CODE_ID=ROMSTART-ROMEND
-Z(CONST)INITTAB,DATA_ID,DATA_C=ROMSTART-ROMEND
-Z(CONST)CHECKSUM=ROMSTART-ROMEND

//
// Define the sections to place into SRAM, and the order to place them.
//
-Z(DATA)VTABLE=RAMSTART-RAMEND
-Z(DATA)DATA_I,DATA_Z,DATA_N=RAMSTART-RAMEND
-Z(DATA)CODE_I=RAMSTART-RAMEND
