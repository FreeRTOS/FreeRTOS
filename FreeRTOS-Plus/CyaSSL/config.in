## FreeRTOS/Demo/T-HEAD_CB2201_CDK/csi/csi_driver/Kconfig
```kconfig
if CONFIG_CSKY
source "../../csi/csi_driver/csky/Kconfig"
endif

if CONFIG_SANECHIPS
source "../../csi/csi_driver/sanechips/Kconfig"
endif
```

## FreeRTOS/Demo/T-HEAD_CB2201_CDK/csi/csi_driver/csky/Kconfig
```kconfig
source "../../csi/csi_driver/csky/common/Kconfig"

if CONFIG_PLATFORM_PHOBOS
source "../../csi/csi_driver/csky/phobos/Kconfig"
endif

if CONFIG_PLATFORM_HOBBIT1_2
source "../../csi/csi_driver/csky/hobbit1_2/Kconfig"
endif
```

## FreeRTOS/Demo/T-HEAD_CB2201_CDK/csi/csi_driver/csky/common/sha/Kconfig
```kconfig
choice
    prompt "select sha type "
        help
          select sha type
config SHA_CK_V2
    bool "csky v2 sha"
    help
        select the ck sha driver

config SHA_CK_V1
    bool "csky v1 sha"
    help
        select the ck sha driver

config SHA_ZX29
    bool "csky zx29 sha"
    help
        select the zx29 sha driver

endchoice
```

## FreeRTOS/Demo/T-HEAD_CB2201_CDK/csi/csi_driver/csky/common/trng/Kconfig
```kconfig
choice
    prompt "select trng type "
        help
          select trng type
config TRNG_CK
    bool "csky trng"
    help
        select the ck trng driver

config TRNG_ZX29
    bool "zx29 trng"
    help
        select the zx29 trng driver

config TRNG_XX
    bool "example trng"
    help
        this option for test

endchoice
```

## FreeRTOS/Demo/T-HEAD_CB2201_CDK/csi/csi_driver/csky/common/usart/Kconfig
```kconfig
choice
    prompt "select usart type "
        help
          select usart type
config USART_DW
    bool "designware usart"
    help
        select the dw usart driver

config USART_CK
    bool "csky usart"
    help
        select the ck usart driver
        
config USART_SILAN
    bool "silan usart"
    help
        select the silan usart driver

config USART_ZX29
    bool "zx29 usart"
    help
        select the zx29 usart driver
endchoice
```

## FreeRTOS/Demo/T-HEAD_CB2201_CDK/csi/csi_driver/csky/common/wdt/Kconfig
```kconfig
choice
    prompt "select wdt type "
        help
          select wdt type
config WDT_DW
    bool "designware wdt"
    help
        select the dw wdt driver

endchoice
```
